/ {
    macros {
        compatible = "zmk,macros";

        macro0: macro_0 {
            compatible = "zmk,behavior-macro";
            label = "Alt + 64 Macro";
            #binding-cells = <0>;
            tap-ms = <50>;
            bindings = <
                &kp LALT
                &kpr N6
                &kpr N4
                &kr LALT  // Suelta la tecla Left Alt
            >;
        };
    };
};
